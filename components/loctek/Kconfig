## components/loctek/Kconfig
```kconfig
menu "Loctek desk control"

    config LOCTEK_UART_NUM
        int "UART controller"
        range 0 4
        default 0
        help
            UART0 is free only once the console moves to USB Serial/JTAG, which
            sdkconfig.defaults does. Otherwise pick another controller.

    config LOCTEK_TX_GPIO
        int "TX GPIO (to control box RJ45 pin 6)"
        default 37
        help
            The defaults are the panel's: M5-Bus TXD0, connector pin 14, with
            GPIO6 (PC_TX, bus pin 16) the alternative if the console is to stay
            on UART0. The companion sets its own in proxy/sdkconfig.defaults.

    config LOCTEK_RX_GPIO
        int "RX GPIO (from control box RJ45 pin 5)"
        default 38
        help
            The defaults are the panel's: M5-Bus RXD0, connector pin 13, with
            GPIO7 (PC_RX, bus pin 15) the alternative. The companion sets its
            own in proxy/sdkconfig.defaults.

    config LOCTEK_WAKE_GPIO
        int "Wake GPIO (to control box RJ45 pin 4, 'PIN 20'), -1 if unwired"
        default 47
        help
            The default is the panel's M5-Bus pin 23; the companion sets its
            own. Must match where the wake wire actually is: driving the wrong
            pin looks exactly like a control box that will not wake.

    config LOCTEK_WAKE_PULSE_MS
        int "Wake pulse, line held high (ms)"
        range 100 3000
        default 1000
        help
            turnon() in the reference implementation: the line rests low, is
            driven high for about a second to wake the panel, then returns low.

    config LOCTEK_NUDGE_WAKE
        bool "Also nudge with a single step if the pulse is not enough"
        default n
        # Off by default on purpose: this physically moves the desk.
        help
            The control box ignores the "no keys pressed" frame but always
            answers a real key. When the panel is found asleep, send one Up
            frame followed by the release frame. One frame is the smallest
            movement the desk can make -- a click rather than a visible move --
            and it makes the box report its height again. Turn this off if you
            would rather the desk never move on its own.

    config LOCTEK_REPEAT_MS
        int "Key repeat interval while moving (ms)"
        range 20 500
        default 50
        help
            The desk moves one step per frame received, and replies to each
            one, so this sets both how smoothly it travels and how often the
            height updates. 108 ms is the upstream ESPHome value; 50 ms is
            smoother on several control boxes.

    config LOCTEK_IDLE_POLL_MS
        int "Idle poll interval (ms), 0 to stay quiet"
        range 0 10000
        default 1000
        help
            Sends a "no keys pressed" frame this often while idle. No upstream
            implementation does this, because they are command-driven and can
            tolerate the first command being swallowed. Here it keeps the box
            responsive: left completely alone it goes fully silent, and in that
            state it ignores movement frames too, so the first button press
            does nothing. Set to 0 to go quiet and accept that.

    config LOCTEK_PRESS_MS
        int "How long a preset or memory key is held (ms)"
        range 50 1500
        default 300
        help
            A key press is a stream of frames, not one frame. Sending a preset
            once registers only sometimes. Must stay well under the five
            seconds of M that triggers a factory reset.

    config LOCTEK_STORE_GAP_MS
        int "Gap between the M key and the preset key when storing (ms)"
        range 100 2000
        default 300
        help
            The control box wants a moment between the two key presses that
            store a preset. Reports suggest values below ~250 ms are flaky.

    config LOCTEK_MIN_HEIGHT_MM
        int "Lowest height the desk can reach (mm)"
        range 300 1500
        default 660

    config LOCTEK_MAX_HEIGHT_MM
        int "Highest height the desk can reach (mm)"
        range 600 2000
        default 1310
        help
            A travel target or a stored preset outside the desk's own range
            is garbage, not a place to drive to.

    config LOCTEK_MOVE_TIMEOUT_MS
        int "Maximum continuous travel (ms)"
        range 1000 120000
        default 30000
        help
            Failsafe: stop the desk if a direction is somehow held this long,
            for instance if a touch release event went missing.

endmenu
```

## components/sound/Kconfig
```kconfig
menu "Notification sound"

    config SOUND_VOLUME
        int "Chime volume (0-100)"
        range 0 100
        default 40
        help
            Codec output volume for the notification chime. The speaker is
            close to the user on a desk, so this wants to be well below what
            sounds reasonable on a bench.

endmenu
```

## components/travel/Kconfig
```kconfig
menu "Travel"

    config TRAVEL_FAKE_MINUTES
        int "Ask about a journey this many minutes from now (development)"
        range 0 600
        default 0
        help
            For working on the panel rather than for using it. Anything above
            zero makes it ask about being somewhere that many minutes from now
            instead of about the next thing in the calendar, which is the only
            way to see a bus without waiting for the morning: OVapi reports
            what is running rather than a timetable, so a journey tomorrow has
            no buses to name yet.

endmenu
```

## components/ui/Kconfig
```kconfig
menu "Screen"

    config UI_KIT
        bool "Build the screen from the design kit (in progress)"
        default n
        help
            The screen as the design kit draws it, being built page by page
            beside the one the panel has had. Until it does all the old one
            does, leave this off: the panel keeps its working screen, and this
            is there to try the new one.

endmenu
```

## components/wifi/Kconfig
```kconfig
menu "Panel time"

    config PANEL_TIMEZONE
        string "Time zone, as a POSIX TZ string"
        default "CET-1CEST,M3.5.0,M10.5.0/3"
        help
            The clock, the calendar and the radar's times are local to this.
            The default is Central European Time with its summer time;
            Europe/London is "GMT0BST,M3.5.0/1,M10.5.0", US Eastern
            "EST5EDT,M3.2.0,M11.1.0".

endmenu
```

## proxy/main/Kconfig.projbuild
```kconfig
menu "Desk proxy"

    config LOCTEK_PROXY_DRY_RUN
        bool "Decode and account for movement commands without sending them"
        default n
        help
            Commands are decoded, the deadman runs and status goes back to the
            panel, but the frames that would actually move the desk are held
            back and logged instead. For testing the whole path with the desk
            standing still.

    config PROXY_LED_BT_GPIO
        int "BT indicator LED GPIO ('BT' on the silkscreen), -1 if unwired"
        default 32
        help
            Drives one of the two LEDs inside the RJ45 jack through a 220R
            series resistor. GPIO32 on the carrier board (row B pin 6, D32).
            Solid while a panel is connected, heartbeat while advertising.

            GPIO32/33 double as the external 32 kHz crystal pins. They are free
            as GPIO only while the RTC runs off the internal RC, which is the
            default and what this build uses.

    config PROXY_LED_DESK_GPIO
        int "Desk indicator LED GPIO ('LINK' on the silkscreen), -1 if unwired"
        default 33
        help
            The other jack LED. GPIO33 on the carrier board (row B pin 7, D33).
            Solid while the control box answers; fast blink when bytes arrive
            but no frame decodes, which is a baud or wiring fault rather than
            silence.

    config PROXY_LED_SELFTEST
        bool "Blink both LEDs at boot"
        default y
        help
            Each LED on its own, then both together. Lets a loose LED clipped to
            one pin prove that pin before the board exists.

endmenu
```
